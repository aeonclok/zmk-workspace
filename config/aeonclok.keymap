#include <behaviors.dtsi>
#include <behaviors/num_word.dtsi> // Requires zmk-auto-layer module.
#include <behaviors/unicode.dtsi> // Requires zmk-unicode module.
#include <zmk-helpers/helper.h> // Requires zmk-helpers module.
#include <dt-bindings/zmk/keys.h>
#include <dt-bindings/zmk/bt.h>
#include <dt-bindings/zmk/mouse.h>


#define QUICK_TAP_MS 175
#define WIN 0
#define MAC 1
#define NUM 2

#define AS(keycode) &as LS(keycode) keycode

#define KEYS_L 0 1 2 3 8 9 10 11 12 18 19 20 21 22 28 29
#define KEYS_R 4 5 6 7 13 14 15 16 17 23 24 25 26 27 36 37
#define KEYS_T 30 31 32 33 34 35

#define COMBO_TERM_FAST 35
#define COMBO_TERM_SLOW 50
#define COMBO_GLOBAL_QUICKTAP 100

//        0  1  2  3       4  5  6  7           <- row 0
//    8  9  10 11 12       13 14 15 16 17       <- row 1
// 18 19 20 21 22             23 24 25 26 27    <- row 2
// 28 29       30 31 32 33 34 35       36 37    <- row 3

// Left Top Row
#define LTR  0  // Left Top Ring
#define LTM  1  // Left Top Middle
#define LTI  2  // Left Top Index
#define LTIS 3  // Left Top Index Side

// Right Top Row
#define RTIS 4
#define RTI  5
#define RTM  6
#define RTR  7

// Left Home Row
#define LHRS 8
#define LHR  9
#define LHM  10
#define LHI  11
#define LHIS 12

// Right Home Row
#define RHIS 13
#define RHI  14
#define RHM  15
#define RHR  16
#define RHRS 17

// Left Bottom Row
#define LHPS 18
#define LHP  19
#define LBR  20
#define LBM  21
#define LBI  22

// Right Bottom Row
#define RBI  23
#define RBM  24
#define RBR  25
#define RHP  26
#define RHPS 27

// Left Row 4
#define LBPS 28
#define LBP  29
#define LTHL  30 // Left Thumb Left
#define LTHM  31 // Left Thumb Middle
#define LTHR  32 // Left Thumb Right

// Right Row 4
#define RTHL  33
#define RTHM  34
#define RTHR  35
#define RBP  36
#define RBPS 37

//#define hmTAPPING_TERM 300
//#define hmTAPPING_TERM_FAST 200

#define MACRO(_name_, _bindings_)          \
_name_: _name_##_macro {                   \
    compatible     = "zmk,behavior-macro"; \
    #binding-cells = <0>;                  \
    tap-ms         = <1>;                  \
    wait-ms        = <1>;                  \
    bindings       = <_bindings_>;         \
};

/ {
    macros {
        MACRO(backtick,  &kp LS(EQUAL) &kp SPACE)
        MACRO(caret,  &kp LS(RIGHT_BRACKET) &kp SPACE) 
        MACRO(tilde, &kp RA(RIGHT_BRACKET) &kp SPACE)
    };
};

#define MODMORPH(_name_, _bindings_, _bindings_shift_)               \
_name_: _name_##_modmorph {                                          \
    compatible = "zmk,behavior-mod-morph";                           \
    #binding-cells = <0>;                                            \
    bindings = <_bindings_>, <_bindings_shift_>;                     \
    mods = <(MOD_LSFT | MOD_RSFT)>;                                  \
};

#define COMBO(_name_, _bindings_, _key_positions_, _layers_)    \
combo_##_name_ {                                                \
    timeout-ms            = <COMBO_TERM_FAST>;                  \
    require-prior-idle-ms = <COMBO_GLOBAL_QUICKTAP>;            \
    bindings              = <_bindings_>;                       \
    key-positions         = <_key_positions_>;                  \
    layers                = <_layers_>;                         \
};

// Tap: num-word | double-tap: sticky num-layer | Hold: num-layer.
#define SMART_NUM &smart_num NUM 0
ZMK_HOLD_TAP(smart_num, bindings = <&mo>, <&num_dance>; flavor = "balanced";
             tapping-term-ms = <200>; quick-tap-ms = <QUICK_TAP_MS>;)
ZMK_TAP_DANCE(num_dance, bindings = <&num_word NUM>, <&sl NUM>;
              tapping-term-ms = <200>;)


#define MAKE_HRM(NAME, HOLD, TAP, TRIGGER_POS) \
    ZMK_HOLD_TAP(NAME, \
        flavor = "balanced"; \
        tapping-term-ms = <280>; \
        quick-tap-ms = <175>; \
        require-prior-idle-ms = <150>; \
        bindings = <HOLD>, <TAP>; \
        hold-trigger-key-positions = <TRIGGER_POS>; \
        hold-trigger-on-release; \
    )
MAKE_HRM(hml, &kp, &kp, KEYS_R KEYS_T)
MAKE_HRM(hmr, &kp, &kp, KEYS_L KEYS_T)

#define MAKE_HRMS(NAME, HOLD, TAP, TRIGGER_POS) \
    ZMK_HOLD_TAP(NAME, \
        flavor = "balanced"; \
        tapping-term-ms = <280>; \
        quick-tap-ms = <175>; \
        bindings = <HOLD>, <TAP>; \
        hold-trigger-key-positions = <TRIGGER_POS>; \
    )
MAKE_HRMS(hmls, &kp, &kp, KEYS_R KEYS_T)
MAKE_HRMS(hmrs, &kp, &kp, KEYS_L KEYS_T)

#define MAKE_HRMN(NAME, HOLD, TAP, TRIGGER_POS) \
    ZMK_HOLD_TAP(NAME, \
        flavor = "balanced"; \
        tapping-term-ms = <280>; \
        quick-tap-ms = <175>; \
        require-prior-idle-ms = <150>; \
        bindings = <HOLD>, <TAP>; \
        hold-trigger-key-positions = <TRIGGER_POS>; \
        hold-trigger-on-release; \
    )
MAKE_HRMN(hmln, &mo, &kp, KEYS_R KEYS_T)
MAKE_HRMN(hmrn, &mo, &kp, KEYS_L KEYS_T)


// tap: sticky-shift | shift + tap/ double-tap: caps-word | hold: shift
ZMK_MOD_MORPH(smart_shft,
    bindings = <&skq LSHFT>, <&caps_word>;
    mods = <(MOD_LSFT)>;
)
&caps_word {  // mods deactivate caps-word, requires PR #1451
    /delete-property/ ignore-modifiers;
};


// Alt+Tab swapper, requires PR #1366
ZMK_TRI_STATE(switcher_win,
    bindings = <&kt LALT>, <&kp TAB>, <&kt LALT>;
    ignored-key-positions = <12>, <1>;
)
ZMK_TRI_STATE(switcher_mac,
    bindings = <&kt LCMD>, <&kp TAB>, <&kt LCMD>;
    ignored-key-positions = <12>, <1>;
)
ZMK_TRI_STATE(quick_sw_win,
    bindings = <&kt LALT>, <&kp TAB>, <&kt LALT>;
)
ZMK_TRI_STATE(quick_sw_mac,
    bindings = <&kt LCMD>, <&kp TAB>, <&kt LCMD>;
)

/ { 

    combos {
        compatible = "zmk,combos";

//        0             1             2             3             4                  5             6             7             8             9
//
//
//
// ╭─────────────┬─────────────┬─────────────┬─────────────┬─────────────╮    ╭─────────────┬─────────────┬─────────────┬─────────────┬─────────────╮                                                                                                                                 ──────┬─────────────┬─────────────┬───────────┬─────────────╮
//            ┌─────┐       ┌─────┐       ┌─────┐       ┌─────┐                          ┌─────┐       ┌─────┐       ┌─────┐       ┌─────┐
//        F   │hakea│   P   │ Tab │   L   │ { } │   H   │  €  │   B                  W   │     │   G   │ "   │   O   │  ?  │  . :  │     │   Q
//            └──┬──┘    ┌──└──┬──┘──┐ ┌──└──┬──┘──┐ ┌──└──┬──┘──┐                    ┌──└──┬──┘──┐ ┌──└──┬──┘──┐ ┌──└──┬──┘──┐    └──┬──┘
// ├─────────────┼───────│QckSw│Swtch│─│     │ [ ] │─│     │  @  │───────┤    ├───────│     │     │─│ ' ´ │     │─│     │  !  │───────┼─────────────┤                                                                                                                                 ──────┼─────────────┼─────────────┼─────────────┼─────────────┤
//            ┌─────┐    └──┌─────┐──┘ └──┌─────┐──┘ └──┌─────┐──┘                    └──┌─────┐──┘ └──┌─────┐──┘ └──┌─────┐──┘    ┌─────┐
//      7 S   │stnk1│ 5 T   │ Esc │ 3 N   │ ( ) │ 1 K   │     │   V                0 C   │     │ 2 U   │Rtrn │ 4 A   │Bs Dl│ 6 E   │     │ 8 I
//      Ctrl  └──┬──┘ Alt┌──└──┬──┘──Gui──└──┬──┘──Num──└──┬──┘──┐                    ┌──└──┬──┘──Num──└──┬──┘──Gui──└──┬──┘──┐Alt └──┬──┘ Ctrl
// ├─────────────┼───────│Copy │Paste│─│     │ < > │─│     │  $  │───────┤    ├───────│     │     │─│ = % │  :  │─│  |  │ / \ │───────┼─────────────┤                                                                                                                                 ──────┼─────────────┼─────────────┼─────────────┼─────────────┤
//            ┌─────┐    └──┌─────┐──┘ └──┌─────┐──┘ └──┌─────┐──┘                    └──┌─────┐──┘ └──┌─────┐──┘ └──┌─────┐──┘    ┌─────┐
//        J   │     │   D   │ ~ ^ │   R   │ & # │ 9 M   │     │   X                8 Z   │     │   Y   │ + * │   Ä   │ - _ │   Ö   │     │  , ;
//            └──┬──┘       └──┬──┘       └──┬──┘       └──┬──┘                          └──┬──┘       └──┬──┘       └──┬──┘       └──┬──┘
// ╰─────────────┼─────────────┼─────────────┼─────────────┼─────────────┤    ├─────────────┼─────────────┼─────────────┼─────────────┼─────────────╯                                                                                                                                 ──────┼─────────────┼─────────────┼─────────────┼─────────────╯
//
//                                               SmrtShft     Repeater           L2 + Space    L3 + Rtrn
//
//                                           ╰─────────────┼─────────────┤    ├─────────────┼─────────────╯
//
//
//
        // 1 and 1+2 row combos left hand
//        COMBO(tog_hakea,        &tog HAKEA,           0 1, WIN MAC NUM MOUSE NAV HAKEA REPEAT)
//        COMBO(tog_stnk1,        &tog REPEAT,           10 11, WIN MAC NUM MOUSE NAV HAKEA REPEAT)
        COMBO(TAB,              &kp TAB,              LTR LTM, WIN NUM MAC)
        COMBO(br_curly_mac,     &mod_br_curly_mac,    LTR LTM, NUM MAC)
        COMBO(br_curly_win,     &mod_br_curly_win,    LTM LTI, WIN NUM)
        COMBO(br_square,        &mod_br_square,       LTM LHI, WIN NUM MAC)
//        COMBO(switcher_mac,     &switcher_mac,        1 12, MAC NUM)
//        COMBO(quick_sw_mac,     &quick_sw_mac,        11 2, MAC NUM)
//        COMBO(switcher_win,     &switcher_win,        1 12, WIN NUM NUM)
//        COMBO(quick_sw_win,     &quick_sw_win,        11 2, WIN NUM NUM)
//        
//        // 1 and 1+2 row combos right hand
        COMBO(doublequote,      &kp LS(NUMBER_2),     RTI RTM, WIN NUM MAC)
        COMBO(question,         &mod_question_amp,        RTM RTR, WIN NUM MAC)
        COMBO(bang_hash,        &mod_bang_hash,     RTM RHR, WIN NUM MAC)
        COMBO(squot_btick,      &mod_squot_btick,     RHI RTM, WIN NUM MAC)
//        COMBO(copy_mac,         &kp LG(C),            15 6, MAC NUM)
//        COMBO(copy_win,         &kp LC(C),            16 7, WIN NUM NUM)
//
//        // 2 and 2+3 row combos left hand
        COMBO(esc,              &kp CAPS,             LHR LHM, WIN NUM MAC)
        COMBO(br_round,         &mod_br_round,        LHM LHI, WIN NUM MAC)
        COMBO(br_angled_mac,    &mod_br_angled_mac,   LHM LBI, MAC NUM)
        COMBO(br_angled_win,    &mod_br_angled_win,   LHM LBI, WIN NUM)
        COMBO(euro_mac,         &kp LS(NUMBER_4),     LHIS LHI, MAC NUM)
        COMBO(euro_win,         &kp RA(E),            LHIS LHI, WIN NUM)
//
        // 2 and 2+3 row combos right hand
        COMBO(dollar,           &kp RA(NUMBER_4),     RHIS RHI, WIN NUM MAC)
        COMBO(at,               &kp RA(NUMBER_2),     RTIS RTI, WIN NUM MAC)
        COMBO(enter,            &kp RET,              RHI RHM, WIN NUM MAC)
        COMBO(backspace_delete, &mod_bspc_del,        RHM RHR, WIN NUM MAC)
        COMBO(equals_percent,   &mod_equals_percent,  RBI RHM, WIN NUM MAC)
//        COMBO(colon,            &kp LS(DOT),          27 16, WIN NUM MAC)
        COMBO(mod_slashes_win,  &mod_slashes_win,     RHM RBR, WIN NUM)
//        COMBO(mod_slashes_mac,  &mod_slashes_mac,     17 28, MAC)
        COMBO(pipe_mac,         &kp RA(NUMBER_7),     RBM RHR, MAC)
        COMBO(pipe_win,         &kp RA(NON_US_BSLH),  RBM RHR, WIN NUM)
//        COMBO(paste_mac,        &kp LG(V),            25 16, MAC)
//        COMBO(paste_win,        &kp LC(V),            26 17, WIN NUM)
//
//        // 3 row combos left hand
        COMBO(amp_hash,         &mod_amp_hash,        LBM LBI, WIN NUM MAC)
        COMBO(tilde_caret,      &mod_tilde_caret,     LBR LBM, WIN NUM MAC)
//
//        // 3 row combos right hand
        COMBO(plus_asterisk,    &mod_plus_asterisk,   RBI RBM, WIN NUM MAC)
        COMBO(minus,            &kp SLASH,            RBM RBR, WIN NUM MAC)
//      
//        // mixed combos
//        COMBO(toggle_win_mac,   &tog MAC,             30 31 32 33, WIN NUM MAC)
//        COMBO(toggle_mouse,     &tog MOUSE,           6 8, WIN NUM MAC)
//        COMBO(toggle_num,       SMART_NUM,             LHI RHI, WIN NUM MAC)
//        COMBO(toggle_unlock,    &studio_unlock,       4 5, WIN NUM MAC)

    };

    behaviors {
       skq: sticky_key_quick_release {
        compatible = "zmk,behavior-sticky-key";
        #binding-cells = <1>;
        bindings = <&kp>;
        release-after-ms = <1000>;
        quick-release;
        ignore-modifiers;
      };
        lt_bspc_del: layer_tap_backspace_delete {
            compatible = "zmk,behavior-hold-tap";
            #binding-cells = <2>;
            tapping-term-ms = <200>;
            //flavor = "tap-preferred";
            bindings = <&mo>, <&mod_bspc_del>;
        };
        MODMORPH(mod_br_curly_mac, &kp RA(RS(NUMBER_8)), &kp RA(RS(NUMBER_9)))
        MODMORPH(mod_br_curly_win, &kp RA(NUMBER_7), &kp RA(NUMBER_0))
        MODMORPH(mod_br_round, &kp LS(NUMBER_8), &kp LS(NUMBER_9))
        MODMORPH(mod_br_square, &kp RA(NUMBER_8), &kp RA(NUMBER_9))
        MODMORPH(mod_br_angled_win, &kp NON_US_BSLH, &kp LS(NON_US_BSLH))
        MODMORPH(mod_br_angled_mac, &kp GRAVE, &kp LS(GRAVE))
        MODMORPH(mod_bspc_del, &kp BACKSPACE, &kp DELETE)
        MODMORPH(mod_amp_hash, &kp LS(NUMBER_6), &kp LS(NUMBER_3))
        MODMORPH(mod_squot_btick, &kp BACKSLASH, &backtick)
        MODMORPH(mod_equals_percent, &kp LS(NUMBER_0), &kp LS(NUMBER_5))
        MODMORPH(mod_tilde_caret, &tilde, &caret)
        MODMORPH(mod_slashes_mac, &kp LS(NUMBER_7), &kp RA(LS(NUMBER_7)))
        MODMORPH(mod_slashes_win, &kp LS(NUMBER_7), &kp RA(MINUS))
        MODMORPH(mod_plus_asterisk, &kp MINUS ,&kp LS(BACKSLASH))
        MODMORPH(mod_question_amp, &kp LS(MINUS), &kp LS(NUMBER_6))
        MODMORPH(mod_bang_hash, &kp LS(NUMBER_1), &kp LS(NUMBER_3))
  };
    keymap {
    compatible = "zmk,keymap";
      default_layer {
        bindings = <
                          &kp P     &kp L     &kp H     &kp V                         &kp C     &kp G     &kp O     &kp DOT
                &kp F     &hml LALT T &hml LGUI N &kp K &kp B                         &kp W     &kp U &hmr RGUI A &hmr LALT E &kp Z
      &kp RSHFT &hml LCTRL S &kp D  &kp R     &kp M                                   &kp Y     &kp SQT   &kp SEMI  &hmr RCTRL I        &kp LSHFT
      &kp X     &kp J                         &kp A &key_repeat SMART_NUM   SMART_NUM &lt 3 SPACE &lt 1 A                         &kp COMMA &kp Q
        >;
        };

        second_layer {
        bindings = <
                          &trans    &trans    &trans    &trans                        &bt BT_SEL 1 &bt BT_SEL 2 &bt BT_SEL 3 &bt BT_SEL 4
                &trans    &trans    &trans    &trans    &trans                        &trans    &trans    &trans    &trans    &trans
      &trans    &trans    &trans    &trans    &trans                                            &trans    &trans    &trans    &trans    &trans
      &trans    &trans                        &trans    &trans    &trans   &sys_reset &bootloader &trans                      &bt BT_CLR &bt BT_CLR
        >;
        };
        third_layer {
        bindings = <
                          &trans    &trans    &trans    &trans                        &trans    &kp N7    &kp N8    &kp N9
                &trans &hml LALT N5 &hml LGUI N3 &kp N1 &trans                        &kp N0 &kp N4 &hmr RGUI N5 &hmr LALT N6 &trans
      &trans  &hml LCTRL N7 &trans  &trans    &kp N9                                            &kp N1    &kp N2    &kp N3    &hmr RCTRL N6 &trans
      &trans    &trans                        &trans    &trans    &trans    &trans    &trans    &trans                        &trans    &trans
        >;
        };
        fourth_layer {
        bindings = <
                          &trans    &trans    &trans    &trans                        &kp H     &trans   &trans    &trans
                &trans    &trans    &trans    &trans    &trans                        &kp LEFT  &kp J     &kp K     &kp L     &trans
      &trans    &trans    &trans    &trans    &trans                                            &kp DOWN  &kp UP    &kp RIGHT &trans    &trans
      &trans    &trans                        &trans    &trans    &trans    &trans    &trans    &trans                        &trans    &trans
        >;
        };
    };
};

